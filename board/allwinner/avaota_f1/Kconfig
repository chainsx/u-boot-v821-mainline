## board/allwinner/avaota_f1/Kconfig
```kconfig
if TARGET_AVAOTA_F1

config SYS_BOARD
	default "avaota_f1"

config SYS_VENDOR
	default "allwinner"

config SYS_SOC
	default "sunxi"

config SYS_CPU
	default "andes"

config SYS_CONFIG_NAME
	default "avaota_f1"

config TEXT_BASE
	default 0x82000000

config SYS_LOAD_ADDR
	default 0x81000000

config HAS_CUSTOM_SYS_INIT_SP_ADDR
	default y

config CUSTOM_SYS_INIT_SP_ADDR
	default 0x83000000

config SPL_TEXT_BASE
	default 0x02000060

config SPL_STACK
	default 0x02021c00

config SPL_MAX_SIZE
	default 0x13fa0

config SPL_OPENSBI_FDT_ADDR
	hex "OpenSBI device tree load address"
	depends on SPL_OPENSBI
	default 0x80700000

config SPL_BSS_START_ADDR
	default 0x02016000

config SPL_BSS_MAX_SIZE
	default 0xb000

config BOARD_SPECIFIC_OPTIONS
	def_bool y
	select SOC_SUNXI
	select MACH_SUN300I_V821
	select OF_HAS_PRIOR_STAGE if RISCV_SMODE
	select BINMAN if SPL
	select RISCV_ANDES
	select DM_GPIO
	select SUNXI_GPIO
	select SUNXI_NEW_PINCTRL
	select SUPPORT_SPL
	select SPL_IMAGE_TYPE_SUNXI_EGON
	select MMC_SUNXI_HAS_NEW_MODE
	select CLK_SUN300I_V821
	select PINCTRL_SUN300I_V821
	select SPL_DM_GPIO
	select SPL_GPIO

config SPL_IMAGE
	default "spl/sunxi-spl.bin"

endif

config MACH_SUN300I_V821
	bool
```

## configs/avaota_f1_defconfig
```kconfig
CONFIG_RISCV=y
CONFIG_ARCH_RV32I=y
CONFIG_RISCV_MMODE=y
CONFIG_SYS_MALLOC_LEN=0x400000
CONFIG_SYS_MONITOR_LEN=4194304
CONFIG_NR_DRAM_BANKS=1
CONFIG_DEFAULT_DEVICE_TREE="sun300i-v821-avaota-f1"
CONFIG_SPL=y
CONFIG_TARGET_AVAOTA_F1=y
# CONFIG_SPL_SHARES_INIT_SP_ADDR is not set
CONFIG_BOOTSTD_DEFAULTS=y
CONFIG_ENV_SIZE=0x20000
CONFIG_ENV_SECT_SIZE=0x10000
CONFIG_ENV_IS_IN_SPI_FLASH=y
CONFIG_ENV_OFFSET=0x84000
CONFIG_ENV_OFFSET_REDUND=0xa4000
CONFIG_ENV_REDUNDANT=y
CONFIG_ENV_SPI_BUS=0
CONFIG_ENV_SPI_CS=0
CONFIG_ENV_SPI_MAX_HZ=30000000
CONFIG_ENV_SPI_MODE=0
CONFIG_SF_DEFAULT_SPEED=30000000
CONFIG_BOOTDELAY=2
CONFIG_SYS_PBSIZE=1050
CONFIG_SYS_PROMPT="avaota-f1 => "
CONFIG_CPU=y
CONFIG_CPU_RISCV=y
# CONFIG_SPL_CPU is not set
# CONFIG_ANDES_PLICSW is not set
# CONFIG_SMP is not set
# CONFIG_SPL_SMP is not set
CONFIG_OF_CONTROL=y
CONFIG_OF_SEPARATE=y
CONFIG_DM=y
CONFIG_DM_SERIAL=y
CONFIG_SYS_NS16550=y
CONFIG_DEBUG_UART=y
CONFIG_DEBUG_UART_NS16550=y
CONFIG_DEBUG_UART_BOARD_INIT=y
CONFIG_DEBUG_UART_BASE=0x42500000
CONFIG_DEBUG_UART_CLOCK=192000000
CONFIG_DEBUG_UART_SHIFT=2
CONFIG_DEBUG_UART_ANNOUNCE=y
# CONFIG_AVAILABLE_HARTS is not set
CONFIG_TIMER=y
CONFIG_TIMER_EARLY=y
CONFIG_SPL_TIMER=y
CONFIG_SPL_TIMER_EARLY=y
CONFIG_CLK=y
CONFIG_CLK_SUNXI=y
CONFIG_PINCTRL=y
CONFIG_PINCTRL_SUN300I_V821=y
CONFIG_MMC=y
CONFIG_DM_MMC=y
CONFIG_MMC_SUNXI=y
CONFIG_SPL_DM=y
CONFIG_SPL_OF_CONTROL=y
CONFIG_SPL_DM_SERIAL=y
CONFIG_SPL_CLK=y
CONFIG_SPL_PINCTRL=y
CONFIG_SPL_PINCTRL_SUN300I_V821=y
CONFIG_SPL_MMC=y
CONFIG_SPL_DM_MMC=y
CONFIG_SPL_MMC_SUNXI=y
CONFIG_SPL_SPI=y
CONFIG_SPL_DM_SPI=y
CONFIG_SPL_SPI_FLASH_SUPPORT=y
CONFIG_SPL_DM_SPI_FLASH=y
CONFIG_SPL_SPI_LOAD=y
CONFIG_SPL_RAW_IMAGE_SUPPORT=y
CONFIG_SPL_PAD_TO=0x12000
CONFIG_SYS_SPI_U_BOOT_OFFS=0x12000
CONFIG_SPI=y
CONFIG_DM_SPI=y
CONFIG_SPI_SUNXI_SPIF=y
CONFIG_DM_SPI_FLASH=y
CONFIG_SPI_FLASH=y
CONFIG_SPI_FLASH_GIGADEVICE=y
CONFIG_SPI_FLASH_MACRONIX=y
CONFIG_SPI_FLASH_STMICRO=y
CONFIG_SPI_FLASH_WINBOND=y
CONFIG_SPI_FLASH_XMC=y
CONFIG_SPI_FLASH_PUYA=y
CONFIG_SPI_FLASH_XTX=y
CONFIG_MTD=y
CONFIG_DM_MTD=y
CONFIG_SPI_FLASH_MTD=y
CONFIG_CMD_MMC=y
CONFIG_CMD_UFETCH=y
CONFIG_CMD_GPIO=y
CONFIG_CMD_MTD=y
CONFIG_CMD_SPI=y
CONFIG_CMD_SF=y
CONFIG_BAUDRATE=115200
```

## configs/avaota_f1_smode_defconfig
```kconfig
CONFIG_RISCV=y
CONFIG_TEXT_BASE=0x80600000
CONFIG_NR_DRAM_BANKS=1
CONFIG_SF_DEFAULT_SPEED=30000000
CONFIG_SPL_DM_SPI=y
CONFIG_DEFAULT_DEVICE_TREE="sun300i-v821-avaota-f1"
CONFIG_SYS_MONITOR_LEN=4194304
CONFIG_SPL_MMC=y
CONFIG_SYS_LOAD_ADDR=0x80800000
CONFIG_BAUDRATE=115200
CONFIG_SPL=y
CONFIG_DEBUG_UART_BASE=0x42500000
CONFIG_DEBUG_UART_CLOCK=192000000
CONFIG_DEBUG_UART_BOARD_INIT=y
CONFIG_SPL_SPI_FLASH_SUPPORT=y
CONFIG_SPL_SPI=y
CONFIG_SPL_TEXT_BASE=0x02000060
CONFIG_TARGET_AVAOTA_F1=y
CONFIG_RISCV_SMODE=y
# CONFIG_SPL_CPU is not set
# CONFIG_SPL_SMP is not set
# CONFIG_AVAILABLE_HARTS is not set
CONFIG_FIT=y
CONFIG_SPL_LOAD_FIT=y
CONFIG_SPL_HAS_LOAD_FIT_ADDRESS=y
CONFIG_SPL_LOAD_FIT_ADDRESS=0x80e00000
CONFIG_SPL_MAX_SIZE=0x13fa0
CONFIG_SPL_BSS_START_ADDR=0x02016000
CONFIG_SPL_BSS_MAX_SIZE=0xb000
CONFIG_SPL_OPENSBI_LOAD_ADDR=0x80000000
CONFIG_SPL_OPENSBI_FDT_ADDR=0x80700000
CONFIG_SPL_OPENSBI_SCRATCH_OPTIONS=0x0
CONFIG_BOOTSTD_FULL=y
# CONFIG_BOOTSTD_DEFAULTS is not set
# CONFIG_BOOTSTD_BOOTCOMMAND is not set
CONFIG_BOOTMETH_EXTLINUX=y
# CONFIG_BOOTMETH_GLOBAL is not set
# CONFIG_BOOTMETH_EXTLINUX_PXE is not set
# CONFIG_BOOTMETH_EFILOADER is not set
# CONFIG_BOOTMETH_EFI_BOOTMGR is not set
# CONFIG_BOOTMETH_VBE is not set
# CONFIG_BOOTMETH_SCRIPT is not set
CONFIG_SYS_PBSIZE=1050
CONFIG_BOARD_LATE_INIT=y
CONFIG_SPL_PAD_TO=0x14000
# CONFIG_SPL_RAW_IMAGE_SUPPORT is not set
# CONFIG_SPL_DOS_PARTITION is not set
# CONFIG_SPL_EFI_PARTITION is not set
# CONFIG_SPL_SHA1 is not set
# CONFIG_SPL_SHA256 is not set
# CONFIG_SPL_CRC8 is not set
# CONFIG_SPL_SHARES_INIT_SP_ADDR is not set
CONFIG_SPL_DM_SPI_FLASH=y
CONFIG_SPL_SPI_LOAD=y
CONFIG_SYS_SPI_U_BOOT_OFFS=0x20000
CONFIG_SYS_PROMPT="avaota-f1 => "
# CONFIG_TOOLS_MKEFICAPSULE is not set
CONFIG_HUSH_PARSER=y
# CONFIG_CMD_UFETCH is not set
CONFIG_CMD_GPIO=y
CONFIG_CMD_MMC=y
CONFIG_CMD_MTD=y
CONFIG_CMD_SPI=y
CONFIG_SPL_CLK=y
CONFIG_MMC=y
CONFIG_DM_MTD=y
CONFIG_SPI_FLASH_PUYA=y
CONFIG_SPI_FLASH_MTD=y
CONFIG_PINCTRL=y
CONFIG_SPL_PINCTRL=y
CONFIG_DEBUG_UART_NS16550=y
CONFIG_DEBUG_UART_SHIFT=2
CONFIG_SYS_NS16550=y
CONFIG_SPI=y
CONFIG_SPI_SUNXI_SPIF=y
CONFIG_SYSRESET=y
CONFIG_TIMER_EARLY=y
# CONFIG_EFI_LOADER is not set
# CONFIG_NET is not set
# CONFIG_NETDEVICES is not set
# CONFIG_CMD_NET is not set
# CONFIG_CMD_PXE is not set
# CONFIG_FS_EXT4 is not set
# CONFIG_CMD_EXT2 is not set
# CONFIG_CMD_EXT4 is not set
# CONFIG_EFI_PARTITION is not set
```
